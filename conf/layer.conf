## conf/layer.conf
```bitbake
# We have a conf and classes directory, add to BBPATH
BBPATH .= ":${LAYERDIR}"

# We have a recipes-* directories, add to BBFILES
BBFILES += "${LAYERDIR}/recipes-*/*/*.bb \
	${LAYERDIR}/recipes-*/*/*.bbappend"

BBFILE_COLLECTIONS += "vcoreiii"
BBFILE_PATTERN_vcoreiii = "^${LAYERDIR}/"
BBFILE_PRIORITY_vcoreiii = "6"
```

## conf/machine/include/vcoreiii.inc
```bitbake
#@TYPE: Machine
#@NAME: vcoreiii

#@DESCRIPTION: Machine configuration for vcoreiii systems

include conf/machine/include/soc-family.inc
require conf/machine/include/tune-mips32.inc

DEFAULTTUNE = "mips32el-nf"

MACHINE_FEATURES = "ext2 ext3 serial"

KERNEL_IMAGETYPE = "vmlinux"
KERNEL_IMAGE_STRIP_EXTRA_SECTIONS  = ".comment"

PREFERRED_PROVIDER_virtual/kernel ?= "linux-yocto"
PREFERRED_VERSION_linux-yocto ?= "3.14%"

SERIAL_CONSOLE = "115200 ttyS0"

MACHINE_EXTRA_RRECOMMENDS = " kernel-modules"

# No getty by default
SYSVINIT_ENABLED_GETTYS = ""

# Loose the RTC - don't have it
MACHINE_FEATURES_BACKFILL_CONSIDERED = "rtc"

IMAGE_FSTYPES ?= "squashfs-xz"

IMAGE_DEPENDS_squashfs-xz = "squashfs-tools-native"
```

## conf/machine/jaguar1-cu24.conf
```bitbake
#@TYPE: Machine
#@NAME: jaguar1-cu24

#@DESCRIPTION: Machine configuration for jaguar1-cu24 vcoreiii systems

SOC_FAMILY = "jaguar1"

require conf/machine/include/vcoreiii.inc
```

## conf/machine/jaguar1-cu48.conf
```bitbake
#@TYPE: Machine
#@NAME: jaguar1-cu48

#@DESCRIPTION: Machine configuration for jaguar1-cu48 systems

SOC_FAMILY = "jaguar1-dual"

require conf/machine/include/vcoreiii.inc
```

## conf/machine/jaguar1.conf
```bitbake
#@TYPE: Machine
#@NAME: jaguar1

#@DESCRIPTION: Machine configuration for vcoreiii systems

require vcoreiii.inc
```

## conf/machine/jaguar2-cu24.conf
```bitbake
#@TYPE: Machine
#@NAME: jaguar2-cu24

#@DESCRIPTION: Machine configuration for jaguar2-cu24 systems

SOC_FAMILY = "jaguar2"

require conf/machine/include/vcoreiii.inc
```

## conf/machine/jaguar2-cu48.conf
```bitbake
#@TYPE: Machine
#@NAME: jaguar2-cu48

#@DESCRIPTION: Machine configuration for jaguar2-cu48 systems

SOC_FAMILY = "jaguar2"

require conf/machine/include/vcoreiii.inc
```

## conf/machine/jaguar2.conf
```bitbake
#@TYPE: Machine
#@NAME: jaguar2

#@DESCRIPTION: Machine configuration for vcoreiii systems

require vcoreiii.inc
```

## conf/machine/luton10.conf
```bitbake
#@TYPE: Machine
#@NAME: luton10

#@DESCRIPTION: Machine configuration for luton10 vcoreiii systems

SOC_FAMILY = "luton26"

require conf/machine/include/vcoreiii.inc
```

## conf/machine/luton26.conf
```bitbake
#@TYPE: Machine
#@NAME: luton26

#@DESCRIPTION: Machine configuration for luton26 vcoreiii systems

SOC_FAMILY = "luton26"

require conf/machine/include/vcoreiii.inc
```

## conf/machine/serval1.conf
```bitbake
#@TYPE: Machine
#@NAME: serval1

#@DESCRIPTION: Machine configuration for serval1 systems

SOC_FAMILY = "serval1"

require conf/machine/include/vcoreiii.inc
```

## conf/machine/serval2.conf
```bitbake
#@TYPE: Machine
#@NAME: serval2

#@DESCRIPTION: Machine configuration for vcoreiii systems

require vcoreiii.inc
```

## conf/machine/servalt.conf
```bitbake
#@TYPE: Machine
#@NAME: servalt

#@DESCRIPTION: Machine configuration for serval-t systems

SOC_FAMILY = "servalt"

require conf/machine/include/vcoreiii.inc
```

## conf/machine/vcoreiii-lu26.conf
```bitbake
#@TYPE: Machine
#@NAME: vcoreiii-lu26

#@DESCRIPTION: Machine configuration for vcoreiii systems

require vcoreiii.inc
```

## conf/machine/vcoreiii.conf
```bitbake
#@TYPE: Machine
#@NAME: vcoreiii

#@DESCRIPTION: Machine configuration for generic vcoreiii system (only for SDK generation)

SOC_FAMILY = "vcoreiii"

IMAGE_FSTYPES = "tar.gz"

require conf/machine/include/vcoreiii.inc
```

## conf/machine/vcoreiii.inc
```bitbake
#@TYPE: Machine
#@NAME: vcoreiii

#@DESCRIPTION: Machine configuration for vcoreiii systems

require conf/machine/include/tune-mips32.inc

DEFAULTTUNE = "mips32el-nf"

MACHINE_FEATURES = "ext2 ext3 serial"

KERNEL_IMAGETYPE = "vmlinux"
KERNEL_IMAGE_STRIP_EXTRA_SECTIONS  = ".comment"

PREFERRED_PROVIDER_virtual/kernel ?= "linux-yocto"
PREFERRED_VERSION_linux-yocto ?= "3.14%"

SERIAL_CONSOLE = "115200 ttyS0"

MACHINE_EXTRA_RRECOMMENDS = " kernel-modules"

IMAGE_FSTYPES ?= "squashfs-xz jffs2"

IMAGE_DEPENDS_squashfs-xz = "squashfs-tools-native"
```

## recipes-kernel/linux/linux-yocto/defconfig
```kconfig
CONFIG_CPU_LITTLE_ENDIAN=y
CONFIG_DEBUG_KERNEL=y
CONFIG_JFFS2_FS=y
CONFIG_DEVTMPFS_MOUNT=y
CONFIG_DEVTMPFS=y
CONFIG_EMBEDDED=y
CONFIG_EXPERT=y
CONFIG_I2C=y
CONFIG_INET=y
CONFIG_MTD_BLKDEVS=y
CONFIG_MTD_BLOCK=y
CONFIG_MTD_CMDLINE_PARTS=y
CONFIG_MTD_M25P80=y
CONFIG_MTD_NAND_ECC=y
CONFIG_MTD_NAND_IDS=y
CONFIG_MTD_NAND_PLATFORM=y
CONFIG_MTD_NAND=y
CONFIG_MTD=y
CONFIG_NET=y
CONFIG_NETDEVICES=y
CONFIG_NET_VENDOR_VITESSE=y
CONFIG_TUN=y
CONFIG_NLATTR=y
CONFIG_PACKET=y
CONFIG_UNIX=y
CONFIG_PRINTK_TIME=y
CONFIG_SERIAL_8250_CONSOLE=y
CONFIG_SERIAL_8250_NR_UARTS=1
CONFIG_SERIAL_8250_RUNTIME_UARTS=1
CONFIG_SERIAL_8250=y
CONFIG_SERIAL_CORE_CONSOLE=y
CONFIG_SERIAL_CORE=y
CONFIG_SPI_BITBANG=y
CONFIG_SPI_MASTER=y
CONFIG_SPI=y
CONFIG_SQUASHFS_XZ=y
CONFIG_SQUASHFS=y
CONFIG_VLAN_8021Q=y
CONFIG_XZ_DEC=y
CONFIG_ZLIB_INFLATE=y
CONFIG_UIO=y
CONFIG_UIO_PDRV_GENIRQ=y
CONFIG_BLK_DEV_INITRD=y
CONFIG_BLK_DEV_RAM=y
CONFIG_CC_OPTIMIZE_FOR_SIZE=y
# CONFIG_INPUT is not set
# CONFIG_SERIO is not set
# CONFIG_SHMEM is not set
# CONFIG_SUSPEND is not set
# CONFIG_SWAP is not set
# CONFIG_USB_SUPPORT is not set
# CONFIG_VT is not set
# CONFIG_WIRELESS is not set
# CONFIG_IDE is not set
# CPU_R4K_FPU is not set
CONFIG_POSIX_MQUEUE=y
CONFIG_UNION_FS=y
CONFIG_UNION_FS_XATTR=y
CONFIG_UNION_FS_DEBUG=y
CONFIG_GPIO_SYSFS=y
CONFIG_MTD_SPLIT_VIMAGE_FW=y
CONFIG_MTD_ROOTFS_ROOT_DEV=y
CONFIG_MTD_SPLIT_FIRMWARE=y
CONFIG_MTD_SPLIT_FIRMWARE_NAME="linux"
# CONFIG_MTD_UIMAGE_SPLIT is not set
CONFIG_MTD_UBI=y
# CONFIG_WLAN is not set
# CONFIG_HW_RANDOM is not set
# CONFIG_HWMON is not set
# CONFIG_THERMAL is not set
# CONFIG_CRAMFS is not set
# CONFIG_NETWORK_FILESYSTEMS is not set
# CONFIG_CRYPTO_HW is not set
CONFIG_MODULES=y
CONFIG_MODULE_UNLOAD=y
```
